## examples/loadelf/Kconfig
```kconfig
#
# For a description of the syntax of this configuration file,
# see the file kconfig-language.txt in the NuttX tools repository.
#

menuconfig EXAMPLES_LOADELF
	tristate "Loadable ELF examples"
	default n
	---help---
		Enable support files and tests for loadable ELF examples.

if EXAMPLES_LOADELF

config EXAMPLES_LOADELF_MIIO_BT_BUILTIN
	bool "Register miio_bt static library as a builtin app"
	default n
	depends on NSH_BUILTIN_APPS
	---help---
		Register an externally built miio_bt static library as the NSH
		builtin command "miio_bt". The library must export miio_bt_main().

config EXAMPLES_LOADELF_MIIO_BT_LIB
	string "miio_bt static library path"
	default "/home/mi/works/gitlab/miio_bt_builder/platforms/midc/libmiio_bt.a"
	depends on EXAMPLES_LOADELF_MIIO_BT_BUILTIN
	---help---
		Absolute or build-relative path to libmiio_bt.a.

config EXAMPLES_LOADELF_MIIO_BT_PRIORITY
	int "miio_bt task priority"
	default 100
	depends on EXAMPLES_LOADELF_MIIO_BT_BUILTIN

config EXAMPLES_LOADELF_MIIO_BT_STACKSIZE
	int "miio_bt stack size"
	default DEFAULT_TASK_STACKSIZE
	depends on EXAMPLES_LOADELF_MIIO_BT_BUILTIN

endif
```

## examples/sim_posix/Kconfig
```kconfig
#
# For a description of the syntax of this configuration file,
# see the file kconfig-language.txt in the NuttX tools repository.
#

config EXAMPLES_SIM_POSIX
	tristate "Sim POSIX regression test"
	default n
	depends on ARCH_SIM
	depends on FS_HOSTFS
	depends on LIBC_NETDB
	depends on NET && NET_USRSOCK && SIM_NETUSRSOCK
	depends on NET_SOCKOPTS && NET_USRSOCK_TCP
	depends on PATH_MAX >= 384
	depends on !NET_LOCAL
	---help---
		Enable a sim regression test for POSIX APIs backed by hostfs,
		netdb, and sim usrsock.

if EXAMPLES_SIM_POSIX

config EXAMPLES_SIM_POSIX_PROGNAME
	string "Program name"
	default "sim_posix"
	---help---
		This is the name of the program that will be used when the NSH ELF
		program is installed.

config EXAMPLES_SIM_POSIX_PRIORITY
	int "Sim POSIX test task priority"
	default 100

config EXAMPLES_SIM_POSIX_STACKSIZE
	int "Sim POSIX test stack size"
	default 8192

endif
```
